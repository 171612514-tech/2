/*
 * Copyright (c) 2020 ZMK Contributors
 *
 * SPDX-License-Identifier: MIT
 */
 
#include "charybdis.dtsi"



&kscan0 {
	col-gpios = <
            &gpio1 6  (GPIO_ACTIVE_HIGH | GPIO_PULL_DOWN),
            &gpio0 31 (GPIO_ACTIVE_HIGH | GPIO_PULL_DOWN)
        >;
};


